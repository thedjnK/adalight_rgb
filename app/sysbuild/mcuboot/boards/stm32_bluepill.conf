## app/sysbuild/mcuboot/boards/stm32_bluepill.conf
```kconfig
CONFIG_SINGLE_APPLICATION_SLOT=y
CONFIG_BOOT_VALIDATE_SLOT0=n
CONFIG_BOOT_SERIAL_IMG_GRP_HASH=n
CONFIG_MBEDTLS=n
CONFIG_BOOT_MAX_IMG_SECTORS=64
CONFIG_ZEPHYR_TRY_MASS_ERASE=n
CONFIG_MCUBOOT_SERIAL=y
CONFIG_BOOT_SERIAL_CDC_ACM=y
CONFIG_BOOT_SERIAL_DETECT_DELAY=50
CONFIG_CLOCK_CONTROL=y
CONFIG_UART_STM32=n
CONFIG_SOC_SERIES_STM32F1X=y
CONFIG_SOC_STM32F103X8=y
CONFIG_FP16=n
CONFIG_MAIN_STACK_SIZE=8064
CONFIG_ISR_STACK_SIZE=1792
CONFIG_TIMEOUT_64BIT=n
CONFIG_FLASH=y
CONFIG_CBPRINTF_NANO=y
CONFIG_PRINTK=n
CONFIG_ASSERT_VERBOSE=n
CONFIG_LOG=n
CONFIG_DEBUG=n
CONFIG_SIZE_OPTIMIZATIONS=y
CONFIG_DEBUG_OPTIMIZATIONS=n
CONFIG_BOOT_BANNER=n
CONFIG_PRINTK=n
CONFIG_EARLY_CONSOLE=n
```

## boards/arm/stm32_bluepill/Kconfig.board
```kconfig
# STM32 Bluepill
# SPDX-License-Identifier: Apache-2.0

config BOARD_STM32_BLUEPILL
	bool "STM32 Bluepill"
	depends on SOC_STM32F103X8
```

## boards/arm/stm32_bluepill/Kconfig.defconfig
```kconfig
# STM32 Bluepill
# SPDX-License-Identifier: Apache-2.0

if BOARD_STM32_BLUEPILL

config BOARD
	default "stm32_bluepill"

endif # BOARD_STM32_BLUEPILL
```

## boards/arm/stm32_bluepill/stm32_bluepill_defconfig
```kconfig
# SPDX-License-Identifier: Apache-2.0

CONFIG_SOC_SERIES_STM32F1X=y
CONFIG_SOC_STM32F103X8=y

# Enable UART driver
CONFIG_SERIAL=y

# Enable GPIO
CONFIG_GPIO=y

# Enable clock control
CONFIG_CLOCK_CONTROL=y

# Enable pin control
CONFIG_PINCTRL=y
```

## west.yml
```yaml
manifest:
  remotes:
    - name: zephyr
      url-base: https://github.com/zephyrproject-rtos

  projects:
    - name: zephyr
      remote: zephyr
      revision: v3.5-branch
      import:
        name-allowlist:
          - cmsis
          - hal_nordic
          - hal_stm32
          - mbedtls
          - mcuboot
          - tinycrypt
          - zcbor

  self:
    path: adalight_rgb
```
